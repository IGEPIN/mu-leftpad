#include <behaviors.dtsi>
#include <dt-bindings/zmk/keys.h>

/ {
    keymap {
        compatible = "zmk,keymap";

        default_layer {
            bindings = <
                &kp LSHIFT    // LSHFT ではなく LSHIFT にしてみる
                &kp LCMD      // LGUI ではなく Mac用の LCMD にしてみる
                &kp Z
            >;
        };
    };
};
